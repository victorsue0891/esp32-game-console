## sdkconfig.defaults
```kconfig
# ESP32-S3 SDK Configuration Defaults

# PSRAM
CONFIG_SPIRAM=y
CONFIG_SPIRAM_MODE_OCT=y
CONFIG_SPIRAM_SPEED_80M=y
CONFIG_SPIRAM_BOOT_INIT=y
CONFIG_SPIRAM_ALLOW_STACK_EXTERNAL_MEMORY=y

# Flash
CONFIG_ESPTOOLPY_FLASHSIZE_16MB=y
CONFIG_ESPTOOLPY_FLASHFREQ_80M=y

# FreeRTOS
CONFIG_FREERTOS_HZ=1000
CONFIG_FREERTOS_UNICORE=n

# SPI
CONFIG_SPI_MASTER_IN_IRAM=y

# JPEG decoder
CONFIG_LV_USE_SJPG=y

# Partition table (OTA-enabled)
CONFIG_PARTITION_TABLE_CUSTOM=y
CONFIG_PARTITION_TABLE_CUSTOM_FILENAME="partitions.csv"

# WiFi
CONFIG_ESP_WIFI_STATIC_RX_BUFFER_NUM=6
CONFIG_ESP_WIFI_DYNAMIC_RX_BUFFER_NUM=16

# NVS
CONFIG_NVS_ENCRYPTION=n

# OTA
CONFIG_BOOTLOADER_APP_ROLLBACK_ENABLE=y
```
